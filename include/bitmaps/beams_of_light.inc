/* Generated by : ImageConverter 565 Online */

/* Image Size     : 13x6 pixels
   Memory usage   : 156 bytes */
const unsigned short beam_1[78] PROGMEM = {
0x0000, 0x0000, 0x0000, 0x0000, 0x0000, 0x0000, 0x0000, 0x0000, 0x0000, 0x0000, 0xFCC0, 0xFCE0, 0x0000, 0x0000, 0x0000, 0x0000,   // 0x0010 (16) pixels
0x0000, 0x0000, 0x0000, 0xFCE0, 0xFCE0, 0xFCE0, 0xFCE0, 0xFCE0, 0xFCE0, 0xFCE0, 0x0000, 0x0000, 0xFCE0, 0xFCE0, 0xFCE0, 0xFCE0,   // 0x0020 (32) pixels
0xFCE0, 0xFCE0, 0xFCE0, 0xFCE0, 0xFCE0, 0xFCE0, 0xFCE0, 0xFCE0, 0xFCE0, 0xFCE0, 0xFCE0, 0xFCE0, 0xFCE0, 0xFCE0, 0xFCE0, 0xFCE0,   // 0x0030 (48) pixels
0xFCE0, 0x0000, 0x0000, 0x0000, 0x0000, 0xFCE0, 0xFCE0, 0xFCE0, 0xFCE0, 0xFCE0, 0x0000, 0x0000, 0x0000, 0x0000, 0x0000, 0x0000,   // 0x0040 (64) pixels
};

/* Image Size     : 13x6 pixels
   Memory usage   : 156 bytes */
const unsigned short beam_2[78] PROGMEM = {
0x0000, 0xFCE0, 0x0000, 0x0000, 0x0000, 0x0000, 0x0000, 0x0000, 0x0000, 0x0000, 0x0000, 0x0000, 0x0000, 0x0000, 0xFCE0, 0xFCE0,   // 0x0010 (16) pixels
0xFCE0, 0xFCE0, 0xFCE0, 0x0000, 0x0000, 0x0000, 0x0000, 0x0000, 0x0000, 0x0000, 0xFCE0, 0xFCE0, 0xFCE0, 0xFCE0, 0xFCE0, 0xFCE0,   // 0x0020 (32) pixels
0xFCE0, 0xFCE0, 0xFCE0, 0x0000, 0x0000, 0x0000, 0x0000, 0x0000, 0x0000, 0xFCE0, 0xFCE0, 0xFCE0, 0xFCE0, 0xFCE0, 0xFCE0, 0xFCE0,   // 0x0030 (48) pixels
0xFCE0, 0xFCE0, 0xFCE0, 0xFCE0, 0x0000, 0x0000, 0x0000, 0x0000, 0x0000, 0xFCE0, 0xFCE0, 0xFCE0, 0xFCE0, 0xFCE0, 0xFCE0, 0xFCE0,   // 0x0040 (64) pixels
};

/* Image Size     : 10x11 pixels
   Memory usage   : 220 bytes */
const unsigned short beam_3[110] PROGMEM = {
0x0000, 0xFCC0, 0x0000, 0x0000, 0x0000, 0x0000, 0x0000, 0x0000, 0x0000, 0x0000, 0xFCE0, 0xFCE0, 0xFCE0, 0x0000, 0x0000, 0x0000,   // 0x0010 (16) pixels
0x0000, 0x0000, 0x0000, 0x0000, 0xFCE0, 0xFCE0, 0xFCE0, 0xFCE0, 0x0000, 0x0000, 0x0000, 0x0000, 0x0000, 0x0000, 0x0000, 0xFCE0,   // 0x0020 (32) pixels
0xFCE0, 0xFCE0, 0xFCE0, 0x0000, 0x0000, 0x0000, 0x0000, 0x0000, 0x0000, 0x0000, 0xFCE0, 0xFCE0, 0xFCE0, 0xFCE0, 0x0000, 0x0000,   // 0x0030 (48) pixels
0x0000, 0x0000, 0x0000, 0x0000, 0x0000, 0xFCE0, 0xFCE0, 0xFCE0, 0xFCE0, 0x0000, 0x0000, 0x0000, 0x0000, 0x0000, 0x0000, 0x0000,   // 0x0040 (64) pixels
0xFCE0, 0xFCE0, 0xFCE0, 0xFCE0, 0x0000, 0x0000, 0x0000, 0x0000, 0x0000, 0x0000, 0x0000, 0xFCE0, 0xFCE0, 0xFCE0, 0xFCE0, 0x0000,   // 0x0050 (80) pixels
0x0000, 0x0000, 0x0000, 0x0000, 0x0000, 0x0000, 0xFCE0, 0xFCE0, 0xFCE0, 0xFCE0, 0x0000, 0x0000, 0x0000, 0x0000, 0x0000, 0x0000,   // 0x0060 (96) pixels
};

/* Image Size     : 5x13 pixels
   Memory usage   : 130 bytes */
const unsigned short beam_4[65] PROGMEM = {
0xFCE0, 0xFCE0, 0x0000, 0x0000, 0x0000, 0xFCE0, 0xFCE0, 0xFCC0, 0x0000, 0x0000, 0xFCE0, 0xFCE0, 0xFCE0, 0x0000, 0x0000, 0xFCE0,   // 0x0010 (16) pixels
0xFCE0, 0xFCE0, 0x0000, 0x0000, 0xFCE0, 0xFCE0, 0xFCE0, 0x0000, 0x0000, 0x0000, 0xFCE0, 0xFCE0, 0xFCE0, 0x0000, 0x0000, 0xFCE0,   // 0x0020 (32) pixels
0xFCE0, 0xFCE0, 0x0000, 0x0000, 0xFCC0, 0xFCE0, 0xFCE0, 0x0000, 0x0000, 0xFCE0, 0xFCE0, 0xFCE0, 0xFCE0, 0x0000, 0x0000, 0xFCE0,   // 0x0030 (48) pixels
0xFCE0, 0xFCE0, 0x0000, 0x0000, 0xFCE0, 0xFCE0, 0xFCE0, 0x0000, 0x0000, 0xFCE0, 0xFCE0, 0xFCE0, 0x0000, 0x0000, 0x0000, 0xFCE0,   // 0x0040 (64) pixels
};

/* Image Size     : 6x12 pixels
   Memory usage   : 144 bytes */
const unsigned short beam_5[72] PROGMEM = {
0x0000, 0x0000, 0xFCE0, 0xFCE0, 0xFCE0, 0x0000, 0x0000, 0x0000, 0xFCE0, 0xFCE0, 0xFCE0, 0x0000, 0x0000, 0x0000, 0xFCE0, 0xFCE0,   // 0x0010 (16) pixels
0xFCE0, 0x0000, 0x0000, 0x0000, 0xFCE0, 0xFCE0, 0xFCE0, 0x0000, 0x0000, 0xFCC0, 0xFCE0, 0xFCE0, 0x0000, 0x0000, 0x0000, 0xFCE0,   // 0x0020 (32) pixels
0xFCE0, 0xFCE0, 0x0000, 0x0000, 0x0000, 0xFCE0, 0xFCE0, 0xFCE0, 0x0000, 0x0000, 0x0000, 0xFCE0, 0xFCE0, 0xFCE0, 0x0000, 0x0000,   // 0x0030 (48) pixels
0xFCE0, 0xFCE0, 0xFCE0, 0x0000, 0x0000, 0x0000, 0xFCE0, 0xFCE0, 0xFCE0, 0x0000, 0x0000, 0x0000, 0xFCE0, 0xFCE0, 0xFCE0, 0x0000,   // 0x0040 (64) pixels
};

/* Image Size     : 11x10 pixels
   Memory usage   : 220 bytes */
const unsigned short beam_6[110] PROGMEM = {
0x0000, 0x0000, 0x0000, 0x0000, 0x0000, 0x0000, 0x0000, 0x0000, 0xFCE0, 0xFCE0, 0x0000, 0x0000, 0x0000, 0x0000, 0x0000, 0x0000,   // 0x0010 (16) pixels
0x0000, 0x0000, 0xFCE0, 0xFCE0, 0xFCE0, 0xFCE0, 0x0000, 0x0000, 0x0000, 0x0000, 0x0000, 0x0000, 0xFCE0, 0xFCE0, 0xFCE0, 0xFCE0,   // 0x0020 (32) pixels
0x0000, 0x0000, 0x0000, 0x0000, 0x0000, 0x0000, 0xFCE0, 0xFCE0, 0xFCE0, 0xFCE0, 0x0000, 0x0000, 0x0000, 0x0000, 0x0000, 0x0000,   // 0x0030 (48) pixels
0xFCE0, 0xFCE0, 0xFCE0, 0xFCE0, 0x0000, 0x0000, 0x0000, 0x0000, 0x0000, 0x0000, 0xFCE0, 0xFCE0, 0xFCE0, 0xFCE0, 0x0000, 0x0000,   // 0x0040 (64) pixels
0x0000, 0x0000, 0x0000, 0x0000, 0xFCE0, 0xFCE0, 0xFCE0, 0xFCE0, 0x0000, 0x0000, 0x0000, 0x0000, 0x0000, 0x0000, 0xFCE0, 0xFCE0,   // 0x0050 (80) pixels
0xFCE0, 0xFCE0, 0x0000, 0x0000, 0x0000, 0x0000, 0x0000, 0x0000, 0xFCE0, 0xFCE0, 0xFCE0, 0xFCE0, 0x0000, 0x0000, 0x0000, 0x0000,   // 0x0060 (96) pixels
};