/* Generated by   : ImageConverter 565 Online */

// Image Size     : 17x8 pixels
// Memory usage   : 272 bytes
const unsigned short b_beam_1[136] = {
0x0000, 0x0000, 0x0000, 0x0000, 0x0000, 0x0000, 0x0000, 0x0000, 0x0000, 0x0000, 0x0000, 0x0000, 0x0000, 0xFCE0, 0xFCE0, 0xFCE0,   // 0x0010 (16) pixels
0x0000, 0x0000, 0x0000, 0x0000, 0x0000, 0x0000, 0x0000, 0x0000, 0x0000, 0x0000, 0xFCE0, 0xFCE0, 0xFCE0, 0xFCE0, 0xFCE0, 0xFCE0,   // 0x0020 (32) pixels
0xFCE0, 0x0000, 0x0000, 0x0000, 0x0000, 0x0000, 0x0000, 0x0000, 0xFCE0, 0xFCE0, 0xFCE0, 0xFCE0, 0xFCE0, 0xFCE0, 0xFCE0, 0xFCE0,   // 0x0030 (48) pixels
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0x0000, 0x0000, 0x0000, 0x0000, 0x0000, 0x0000, 0x0000, 0x0000, 0xFCE0, 0x0000, 0x0000, 0x0000, 0x0000, 0x0000, 0x0000, 0x0000,   // 0x0080 (128) pixels
};

// Image Size     : 17x7 pixels
// Memory usage   : 238 bytes
const unsigned short b_beam_2[119] = {
0x0000, 0xFCE0, 0xFCE0, 0xFCE0, 0xFCE0, 0x0000, 0x0000, 0x0000, 0x0000, 0x0000, 0x0000, 0x0000, 0x0000, 0x0000, 0x0000, 0x0000,   // 0x0010 (16) pixels
0x0000, 0xFCE0, 0xFCE0, 0xFCE0, 0xFCE0, 0xFCE0, 0xFCE0, 0xFCE0, 0xFCE0, 0x0000, 0x0000, 0x0000, 0x0000, 0x0000, 0x0000, 0x0000,   // 0x0020 (32) pixels
0x0000, 0x0000, 0xFCE0, 0xFCE0, 0xFCE0, 0xFCE0, 0xFCE0, 0xFCE0, 0xFCE0, 0xFCE0, 0xFCE0, 0xFCE0, 0xFCE0, 0xFCE0, 0x0000, 0x0000,   // 0x0030 (48) pixels
0x0000, 0x0000, 0x0000, 0x0000, 0xFCC0, 0xFCE0, 0xFCE0, 0xFCE0, 0xFCE0, 0xFCE0, 0xFCE0, 0xFCE0, 0xFCE0, 0xFCE0, 0xFCE0, 0xFCE0,   // 0x0040 (64) pixels
0xFCE0, 0xFCC0, 0xFCE0, 0x0000, 0x0000, 0x0000, 0x0000, 0x0000, 0xFCE0, 0xFCE0, 0xFCE0, 0xFCE0, 0xFCE0, 0xFCE0, 0xFCE0, 0xFCE0,   // 0x0050 (80) pixels
0xFCE0, 0xFCE0, 0xFCE0, 0xFCE0, 0xFCE0, 0x0000, 0x0000, 0x0000, 0x0000, 0x0000, 0x0000, 0x0000, 0x0000, 0xFCE0, 0xFCE0, 0xFCE0,   // 0x0060 (96) pixels
0xFCE0, 0xFCE0, 0xFCE0, 0xFCE0, 0xFCE0, 0x0000, 0x0000, 0x0000, 0x0000, 0x0000, 0x0000, 0x0000, 0x0000, 0x0000, 0x0000, 0x0000,   // 0x0070 (112) pixels
};

// Image Size     : 14x14 pixels
// Memory usage   : 392 bytes
const unsigned short b_beam_3[196] = {
0x0000, 0x0000, 0xFCE0, 0x0000, 0x0000, 0x0000, 0x0000, 0x0000, 0x0000, 0x0000, 0x0000, 0x0000, 0x0000, 0x0000, 0x0000, 0xFCE0,   // 0x0010 (16) pixels
0xFCE0, 0xFCE0, 0x0000, 0x0000, 0x0000, 0x0000, 0x0000, 0x0000, 0x0000, 0x0000, 0x0000, 0x0000, 0xFCE0, 0xFCE0, 0xFCE0, 0xFCE0,   // 0x0020 (32) pixels
0xFCE0, 0x0000, 0x0000, 0x0000, 0x0000, 0x0000, 0x0000, 0x0000, 0x0000, 0x0000, 0x0000, 0xFCC0, 0xFCE0, 0xFCE0, 0xFCE0, 0xFCE0,   // 0x0030 (48) pixels
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0x0000, 0x0000, 0xFCE0, 0xFCE0, 0xFCE0, 0x0000, 0x0000, 0x0000, 0x0000, 0x0000, 0x0000, 0x0000, 0x0000, 0x0000, 0x0000, 0x0000,   // 0x00C0 (192) pixels
};

// Image Size     : 8x17 pixels
// Memory usage   : 272 bytes
const unsigned short b_beam_4[136] = {
0x0000, 0xFCE0, 0xFCE0, 0xFCC0, 0x0000, 0x0000, 0x0000, 0x0000, 0xFCE0, 0xFCE0, 0xFCE0, 0xFCE0, 0x0000, 0x0000, 0x0000, 0x0000,   // 0x0010 (16) pixels
0xFCC0, 0xFCE0, 0xFCE0, 0xFCE0, 0x0000, 0x0000, 0x0000, 0x0000, 0xFCE0, 0xFCE0, 0xFCE0, 0xFCE0, 0x0000, 0x0000, 0x0000, 0x0000,   // 0x0020 (32) pixels
0x0000, 0xFCE0, 0xFCE0, 0xFCE0, 0xFCE0, 0x0000, 0x0000, 0x0000, 0x0000, 0xFCE0, 0xFCE0, 0xFCE0, 0xFCE0, 0x0000, 0x0000, 0x0000,   // 0x0030 (48) pixels
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0x0000, 0x0000, 0x0000, 0xFCE0, 0xFCE0, 0xFCE0, 0xFCE0, 0x0000, 0x0000, 0x0000, 0x0000, 0xFCE0, 0xFCE0, 0xFCE0, 0xFCE0, 0xFCE0,   // 0x0080 (128) pixels
};

// Image Size     : 8x17 pixels
// Memory usage   : 272 bytes
const unsigned short b_beam_5[136] = {
0x0000, 0x0000, 0x0000, 0x0000, 0xFCE0, 0xFCE0, 0x0000, 0x0000, 0x0000, 0x0000, 0x0000, 0x0000, 0xFCE0, 0xFCE0, 0xFCE0, 0xFCE0,   // 0x0010 (16) pixels
0x0000, 0x0000, 0x0000, 0xFCE0, 0xFCE0, 0xFCE0, 0xFCE0, 0x0000, 0x0000, 0x0000, 0x0000, 0xFCE0, 0xFCE0, 0xFCE0, 0xFCE0, 0x0000,   // 0x0020 (32) pixels
0x0000, 0x0000, 0x0000, 0xFCE0, 0xFCE0, 0xFCE0, 0xFCE0, 0x0000, 0x0000, 0x0000, 0x0000, 0xFCE0, 0xFCE0, 0xFCE0, 0xFCE0, 0x0000,   // 0x0030 (48) pixels
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0xFCE0, 0xFCE0, 0xFCE0, 0xFCE0, 0x0000, 0x0000, 0x0000, 0x0000, 0xFCE0, 0xFCE0, 0xFCE0, 0xFCC0, 0x0000, 0x0000, 0x0000, 0x0000,   // 0x0080 (128) pixels
};


// Image Size     : 14x14 pixels
// Memory usage   : 392 bytes
const unsigned short b_beam_6[196] = {
0x0000, 0x0000, 0x0000, 0x0000, 0x0000, 0x0000, 0x0000, 0x0000, 0x0000, 0x0000, 0x0000, 0xFCC0, 0xFCE0, 0x0000, 0x0000, 0x0000,   // 0x0010 (16) pixels
0x0000, 0x0000, 0x0000, 0x0000, 0x0000, 0x0000, 0x0000, 0x0000, 0xFCC0, 0xFCE0, 0xFCE0, 0xFCE0, 0x0000, 0x0000, 0x0000, 0x0000,   // 0x0020 (32) pixels
0x0000, 0x0000, 0x0000, 0x0000, 0x0000, 0xFCC0, 0xFCE0, 0xFCE0, 0xFCE0, 0xFCE0, 0x0000, 0x0000, 0x0000, 0x0000, 0x0000, 0x0000,   // 0x0030 (48) pixels
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0x0000, 0x0000, 0x0000, 0x0000, 0x0000, 0x0000, 0x0000, 0x0000, 0xFCE0, 0xFCE0, 0x0000, 0x0000, 0x0000, 0x0000, 0x0000, 0x0000,   // 0x00C0 (192) pixels
};

